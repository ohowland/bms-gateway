VERSION "0.1"

BU_: IO

BO_ 256 IO_CLOCK: 8 IO
  SG_ IO_CLOCK : 0|64@1+ (1,0) [0|0] "s" IO
BO_ 257 IO_STACK_V: 4 IO
  SG_ IO_STACK_V : 0|32@1- (0.001,0) [0|0] "V" IO
BO_ 258 IO_STACK_I: 4 IO
  SG_ IO_STACK_I : 0|32@1- (0.001,0) [0|0] "A" IO
BO_ 259 IO_SOC: 1 IO
  SG_ IO_SOC : 0|8@1+ (1,0) [0|0] "%" IO
BO_ 260 IO_DOD: 4 IO
  SG_ IO_DOD : 0|32@1- (0.001,0) [0|0] "Ah" IO
BO_ 261 IO_MAX_CELL_V: 4 IO
  SG_ IO_MAX_CELL_V : 0|32@1- (0.001,0) [0|0] "V" IO
BO_ 262 IO_MIN_CELL_V: 4 IO
  SG_ IO_MIN_CELL_V : 0|32@1- (0.001,0) [0|0] "V" IO
BO_ 263 IO_AVG_CELL_V: 4 IO
  SG_ IO_AVG_CELL_V : 0|32@1- (0.001,0) [0|0] "V" IO
BO_ 264 IO_MAX_CELL_TEMP: 2 IO
  SG_ IO_MAX_CELL_TEMP : 0|16@1- (1,0) [0|0] "C" IO
BO_ 265 IO_MIN_CELL_TEMP: 2 IO
  SG_ IO_MIN_CELL_TEMP : 0|16@1- (1,0) [0|0] "C" IO
BO_ 266 IO_AVG_CELL_TEMP: 2 IO
  SG_ IO_AVG_CELL_TEMP : 0|16@1- (1,0) [0|0] "C" IO
BO_ 267 IO_OVERALL_SAFE: 1 IO
  SG_ IO_OVERALL_SAFE : 0|1@1+ (1,0) [0|0] "Bool" IO
BO_ 268 IO_SAFE_TO_CHRG: 1 IO
  SG_ IO_SAFE_TO_CHRG : 0|1@1+ (1,0) [0|0] "Bool" IO
BO_ 269 IO_SAFE_TO_DISCHRG: 1 IO
  SG_ IO_SAFE_TO_DISCHRG : 0|1@1+ (1,0) [0|0] "Bool" IO
BO_ 270 IO_CHRG_I_LIM: 4 IO
  SG_ IO_CHRG_I_LIM : 0|32@1- (0.001,0) [0|0] "mA" IO
BO_ 271 IO_CHRG_PCT_LIM: 1 IO
  SG_ IO_CHRG_PCT_LIM : 0|8@1+ (1,0) [0|0] "%" IO
BO_ 272 IO_DISCHRG_I_LIM: 4 IO
  SG_ IO_DISCHRG_I_LIM : 0|32@1- (0.001,0) [0|0] "mA" IO
BO_ 273 IO_DISCHRG_PCT_LIM: 1 IO
  SG_ IO_DISCHRG_PCT_LIM : 0|8@1+ (1,0) [0|0] "%" IO
BO_ 274 IO_STACK_STATE: 2 IO
  SG_ IO_STACK_STATE : 0|16@1+ (1,0) [0|0] "Enum" IO
BO_ 277 IO_HEARTBEAT: 4 IO
  SG_ IO_HEARTBEAT : 0|32@1+ (1,0) [0|0] "Uint32" IO
BO_ 278 IO_FAULT_STACK_HI_V: 1 IO
  SG_ IO_FAULT_STACK_HI_V : 0|1@1+ (1,0) [0|0] "Bool" IO
BO_ 279 IO_FAULT_STACK_LO_V: 1 IO
  SG_ IO_FAULT_STACK_LO_V : 0|1@1+ (1,0) [0|0] "Bool" IO
BO_ 280 IO_FAULT_TEMP_HI: 1 IO
  SG_ IO_FAULT_TEMP_HI : 0|1@1+ (1,0) [0|0] "Bool" IO
BO_ 281 IO_FAULT_TEMP_LO: 1 IO
  SG_ IO_FAULT_TEMP_LO : 0|1@1+ (1,0) [0|0] "Bool" IO
BO_ 282 IO_FAULT_CHRG_TEMP_HI: 1 IO
  SG_ IO_FAULT_CHRG_TEMP_HI : 0|1@1+ (1,0) [0|0] "Bool" IO
BO_ 283 IO_FAULT_CHRG_TEMP_LO: 1 IO
  SG_ IO_FAULT_CHRG_TEMP_LO : 0|1@1+ (1,0) [0|0] "Bool" IO
BO_ 284 IO_FAULT_STACK_HI_I: 1 IO
  SG_ IO_FAULT_STACK_HI_I : 0|1@1+ (1,0) [0|0] "Bool" IO
BO_ 285 IO_FAULT_STACK_LO_I: 1 IO
  SG_ IO_FAULT_STACK_LO_I : 0|1@1+ (1,0) [0|0] "Bool" IO
BO_ 286 IO_FAULT_CONTACTOR: 1 IO
  SG_ IO_FAULT_CONTACTOR : 0|1@1+ (1,0) [0|0] "Bool" IO
BO_ 287 IO_FAULT_LINKBUS: 1 IO
  SG_ IO_FAULT_LINKBUS : 0|1@1+ (1,0) [0|0] "Bool" IO
BO_ 288 IO_CHRG_V: 4 IO
  SG_ IO_CHRG_V : 0|32@1+ (0.001,0) [0|0] "V" IO
BO_ 289 IO_DISCHRG_V: 4 IO
  SG_ IO_DISCHRG_V : 0|32@1+ (0.001,0) [0|0] "V" IO
